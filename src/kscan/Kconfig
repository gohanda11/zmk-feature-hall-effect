## src/kscan/Kconfig
```kconfig
config HE_KSCAN_DIRECT_PULSED
    bool "Enable HE KSCAN direct pulsed"
    default y
    depends on DT_HAS_HE_KSCAN_DIRECT_PULSED_ENABLED
    select ADC
    select KSCAN

config HE_KSCAN_MULTIPLEXER
    bool "Enable HE KSCAN multiplexer"
    default y
    depends on DT_HAS_HE_KSCAN_MULTIPLEXER_ENABLED
    select ADC
    select KSCAN


rsource "forwarders/Kconfig"
```
